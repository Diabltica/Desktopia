#include "gc9a01.h"
#include "board_pins.h"
#include "config.h"
#include <SPI.h>
#include <avr/pgmspace.h>

namespace {

constexpr uint8_t CMD_CASET = 0x2A;
constexpr uint8_t CMD_RASET = 0x2B;
constexpr uint8_t CMD_RAMWR = 0x2C;
constexpr uint8_t CMD_MADCTL = 0x36;

// MADCTL for rotation 0..3 (MX / MV / MY bits + BGR order), as in Adafruit_GC9A01A::setRotation()
const uint8_t kMadctl[4] PROGMEM = {0x48, 0x28, 0x88, 0xE8};

// Command list: {command, argCount | 0x80 if a 150 ms pause follows, args...}, terminated by 0.
// Generated from Adafruit_GC9A01A's initcmd[].
const uint8_t kInit[] PROGMEM = {
  0xEF, 0x00,
  0xEB, 0x01, 0x14,
  0xFE, 0x00,
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  0x29, 0x80,
  0x00
};

// Classic 5x7 font, ASCII 32..126, 5 column bytes per glyph (bit 0 = top row).
const uint8_t kFont[] PROGMEM = {
  0x00, 0x00, 0x00, 0x00, 0x00, 0x00, 0x00, 0x5F, 0x00, 0x00, 0x00, 0x07, 0x00, 0x07, 0x00, 0x14, 0x7F, 0x14, 0x7F, 0x14,
  0x24, 0x2A, 0x7F, 0x2A, 0x12, 0x23, 0x13, 0x08, 0x64, 0x62, 0x36, 0x49, 0x56, 0x20, 0x50, 0x00, 0x08, 0x07, 0x03, 0x00,
  0x00, 0x1C, 0x22, 0x41, 0x00, 0x00, 0x41, 0x22, 0x1C, 0x00, 0x2A, 0x1C, 0x7F, 0x1C, 0x2A, 0x08, 0x08, 0x3E, 0x08, 0x08,
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  0x00, 0x00, 0x77, 0x00, 0x00, 0x00, 0x41, 0x36, 0x08, 0x00, 0x02, 0x01, 0x02, 0x04, 0x02,
};

inline void spiSend(uint8_t b) {
  SPDR = b;
  while (!(SPSR & _BV(SPIF))) {
  }
}

inline void spiSend16(uint16_t v) {
  spiSend((uint8_t)(v >> 8));
  spiSend((uint8_t)v);
}

inline void csLow() { digitalWrite(pins::LCD_CS, LOW); }
inline void csHigh() { digitalWrite(pins::LCD_CS, HIGH); }
inline void dcCommand() { digitalWrite(pins::LCD_DC, LOW); }
inline void dcData() { digitalWrite(pins::LCD_DC, HIGH); }

uint16_t isqrt(uint32_t n) {                       // floor(sqrt(n))
  uint32_t root = 0;
  uint32_t bit = 1UL << 30;
  while (bit > n) bit >>= 2;
  while (bit) {
    if (n >= root + bit) {
      n -= root + bit;
      root = (root >> 1) + bit;
    } else {
      root >>= 1;
    }
    bit >>= 2;
  }
  return (uint16_t)root;
}

}  // namespace

void Gc9a01::sendCommand(uint8_t cmd, const uint8_t* args, uint8_t count) {
  csLow();
  dcCommand();
  spiSend(cmd);
  dcData();
  for (uint8_t i = 0; i < count; i++) spiSend(pgm_read_byte(args + i));
  csHigh();
}

void Gc9a01::begin(uint8_t rotation) {
  pinMode(pins::LCD_CS, OUTPUT);
  csHigh();
  pinMode(pins::LCD_DC, OUTPUT);
  dcData();
  SPI.begin();
  SPI.beginTransaction(SPISettings(DISPLAY_SPI_HZ, MSBFIRST, SPI_MODE0));   // kept open: the LCD is the only SPI device

  pinMode(pins::LCD_RST, OUTPUT);                  // hardware reset, same timing as the Adafruit library
  digitalWrite(pins::LCD_RST, HIGH);
  delay(100);
  digitalWrite(pins::LCD_RST, LOW);
  delay(100);
  digitalWrite(pins::LCD_RST, HIGH);
  delay(200);

  const uint8_t* p = kInit;
  uint8_t cmd;
  while ((cmd = pgm_read_byte(p++)) != 0) {
    uint8_t flags = pgm_read_byte(p++);
    uint8_t n = flags & 0x7F;
    sendCommand(cmd, p, n);
    p += n;
    if (flags & 0x80) delay(150);
  }

  uint8_t madctl = pgm_read_byte(&kMadctl[rotation & 3]);
  csLow();
  dcCommand();
  spiSend(CMD_MADCTL);
  dcData();
  spiSend(madctl);
  csHigh();
}

void Gc9a01::openWindow(int16_t x0, int16_t y0, int16_t x1, int16_t y1) {
  csLow();
  dcCommand();
  spiSend(CMD_CASET);
  dcData();
  spiSend16((uint16_t)x0);
  spiSend16((uint16_t)x1);
  dcCommand();
  spiSend(CMD_RASET);
  dcData();
  spiSend16((uint16_t)y0);
  spiSend16((uint16_t)y1);
  dcCommand();
  spiSend(CMD_RAMWR);
  dcData();
}

void Gc9a01::closeWindow() { csHigh(); }

void Gc9a01::streamColor(uint16_t color, uint32_t count) {
  uint8_t hi = (uint8_t)(color >> 8);
  uint8_t lo = (uint8_t)color;
  while (count--) {
    spiSend(hi);
    spiSend(lo);
  }
}

void Gc9a01::fillRect(int16_t x, int16_t y, int16_t w, int16_t h, uint16_t color) {
  if (w <= 0 || h <= 0) return;
  if (x < 0) { w = (int16_t)(w + x); x = 0; }
  if (y < 0) { h = (int16_t)(h + y); y = 0; }
  if (x >= kSize || y >= kSize) return;
  if (x + w > kSize) w = (int16_t)(kSize - x);
  if (y + h > kSize) h = (int16_t)(kSize - y);
  if (w <= 0 || h <= 0) return;
  openWindow(x, y, (int16_t)(x + w - 1), (int16_t)(y + h - 1));
  streamColor(color, (uint32_t)w * (uint32_t)h);
  closeWindow();
}

void Gc9a01::fillCircle(int16_t cx, int16_t cy, int16_t r, uint16_t color) {
  for (int16_t dy = -r; dy <= r; dy++) {
    int16_t dx = (int16_t)isqrt((uint32_t)((int32_t)r * r - (int32_t)dy * dy));
    fillRect((int16_t)(cx - dx), (int16_t)(cy + dy), (int16_t)(2 * dx + 1), 1, color);
  }
}

void Gc9a01::fillRing(int16_t cx, int16_t cy, int16_t rOuter, int16_t rInner, uint16_t color) {
  for (int16_t dy = -rOuter; dy <= rOuter; dy++) {
    int16_t dxo = (int16_t)isqrt((uint32_t)((int32_t)rOuter * rOuter - (int32_t)dy * dy));
    int16_t ady = (int16_t)(dy < 0 ? -dy : dy);
    if (ady <= rInner) {                                     // the hole is crossed on this row: two spans
      int16_t dxi = (int16_t)isqrt((uint32_t)((int32_t)rInner * rInner - (int32_t)dy * dy));
      fillRect((int16_t)(cx - dxo), (int16_t)(cy + dy), (int16_t)(dxo - dxi), 1, color);
      fillRect((int16_t)(cx + dxi + 1), (int16_t)(cy + dy), (int16_t)(dxo - dxi), 1, color);
    } else {
      fillRect((int16_t)(cx - dxo), (int16_t)(cy + dy), (int16_t)(2 * dxo + 1), 1, color);
    }
  }
}

void Gc9a01::drawChar(int16_t x, int16_t y, char c, uint8_t scale, uint16_t fg, uint16_t bg) {
  if (scale == 0) return;
  if (c < 32 || c > 126) c = '?';
  int16_t w = (int16_t)(6 * scale);
  int16_t h = (int16_t)(8 * scale);
  if (x < 0 || y < 0 || x + w > kSize || y + h > kSize) return;

  uint8_t col[5];
  const uint8_t* glyph = kFont + (uint16_t)(c - 32) * 5;
  for (uint8_t i = 0; i < 5; i++) col[i] = pgm_read_byte(glyph + i);

  uint8_t fh = (uint8_t)(fg >> 8), fl = (uint8_t)fg, bh = (uint8_t)(bg >> 8), bl = (uint8_t)bg;
  openWindow(x, y, (int16_t)(x + w - 1), (int16_t)(y + h - 1));
  for (uint8_t row = 0; row < 8; row++) {
    for (uint8_t ry = 0; ry < scale; ry++) {
      for (uint8_t cx = 0; cx < 6; cx++) {
        bool on = cx < 5 && row < 7 && ((col[cx] >> row) & 1);
        uint8_t hi = on ? fh : bh;
        uint8_t lo = on ? fl : bl;
        for (uint8_t rx = 0; rx < scale; rx++) {
          spiSend(hi);
          spiSend(lo);
        }
      }
    }
  }
  closeWindow();
}

void Gc9a01::drawText(int16_t x, int16_t y, const char* text, uint8_t scale, uint16_t fg, uint16_t bg) {
  for (; *text; text++) {
    drawChar(x, y, *text, scale, fg, bg);
    x = (int16_t)(x + 6 * scale);
  }
}

void Gc9a01::drawTextP(int16_t x, int16_t y, const __FlashStringHelper* text, uint8_t scale, uint16_t fg, uint16_t bg) {
  const char* p = reinterpret_cast<const char*>(text);
  for (char c; (c = (char)pgm_read_byte(p)) != 0; p++) {
    drawChar(x, y, c, scale, fg, bg);
    x = (int16_t)(x + 6 * scale);
  }
}
